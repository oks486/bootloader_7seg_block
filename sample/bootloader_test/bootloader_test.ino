/*
  bootloader_test.ino
  oaks@oks486
 */


char str[] = "0123456789ABCDEF"; 

char command_write[] = {0xaa,0x55,0xaa,0xff,0xaa}; 
char command_exec[] = {0xaa,0x55,0xaa,0x00,0x55}; 

char user_program[] = "\
:10000000FF3F0528FF3FFF3FFF3F0628200008284D\
:10001000FA017830210099001A1C0C283F3020008A\
:100020008C003F308E00043024008C0023008C01B3\
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:10018000332838283D28422847284C28FF3FFF3F86\
:00000001FF\
";

void setup() {
  Serial.begin(9600);
  delay (1000);
}

void loop() {

  // send command for writing user program
  for (int i = 0; i < sizeof(command_write); i++){
    Serial.write(command_write[i]);
  }
  delay(250);

  // write user program
  for (long i = 0; i < sizeof(user_program); i++){
    if (user_program[i] == ':') {
      delay(5);
    }
    Serial.write(user_program[i]);
  }

  // send command for running user program
  for (int i = 0; i < sizeof(command_exec); i++){
    Serial.write(command_exec[i]);
  }

  // display
  while(1) {
    for (int i = 0; i < sizeof(str) - 1; i++){
      Serial.write(str[i]);
      delay(100);
      Serial.write(str[i]);
      delay(100);
      Serial.write(0x0d);
      delay(100);
    }
  }

}

